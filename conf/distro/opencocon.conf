## conf/distro/opencocon.conf
```bitbake
#-----------------------------------------------------------------------------
#@TYPE: Distribution
#@NAME: opencocon
#@DESCRIPTION: Linux distribution for old computer
#
#@COMMENT: www.opencocon.org
#-----------------------------------------------------------------------------

include conf/distro/include/default-providers.inc
include conf/distro/include/default-versions.inc
include conf/distro/include/default-distrovars.inc
include conf/distro/include/world-broken.inc

TCLIBC = "uclibc"
require conf/distro/include/tclibc-${TCLIBC}.inc

TCMODE = "default"
require conf/distro/include/tcmode-${TCMODE}.inc

CACHE = "${TMPDIR}/cache/${TCMODE}-${TCLIBC}${@['', '/' + str(d.getVar('MACHINE', True))][bool(d.getVar('MACHINE', True))]}${@['', '/' + str(d.getVar('SDKMACHINE', True))][bool(d.getVar('SDKMACHINE', True))]}"


#
# Header
#
DISTRO_NAME = "opencocon"
DISTRO_VERSION = "v4"

DISTRO_TYPE = "release"
#DISTRO_TYPE = "debug"


#INHERIT += "debian"
IMAGE_PKGTYPE = "ipk"

INHERIT += "package_ipk"

ONLINE_PACKAGE_MANAGEMENT = "none"
#OPKG_SRCREV ?= "541"

# Put links to sources in deploy/sources to make it easier for people to be GPL compliant
#INHERIT += "src_distribute_local"
SRC_DIST_LOCAL ?= "symlink"


# increase inode/block ratio for ext2 filesystem
#EXTRA_IMAGECMD_ext2 = "-i 8192"

# Global Setting
#USE_NLS ?= "yes"

PREFERRED_PROVIDER_virtual/update-alternatives = "opkg"
PREFERRED_PROVIDER_hotplug  = "udev"
PREFERRED_VERSION_udev = "175"

# KERNEL
LINUX_LIBC_HEADERS_VERSION = "3.0.33"
PREFERRED_VERSION_linux-libc-headers = "${LINUX_LIBC_HEADERS_VERSION}"
PREFERRED_VERSION_linux-libc-headers-native = "${LINUX_LIBC_HEADERS_VERSION}"
PREFERRED_VERSION_linux-libc-headers-nativesdk = "${LINUX_LIBC_HEADERS_VERSION}"


# uClibc Setting
LIBC = "uclibc"
#PREFERRED_PROVIDER_virtual/libc = "uclibc"
PREFERRED_PROVIDER_virtual/${TARGET_PREFIX}libc-for-gcc = "uclibc"
PREFERRED_PROVIDER_virtual/i486-linux-uclibc-libc-initial = "uclibc-initial"
PREFERRED_VERSION_uclibc = "0.9.33"
PREFERRED_VERSION_uclibc-initial = "0.9.33"
TARGET_LINK_HASH_STYLE = "-Wl,--hash-style=gnu"

# Busybox Setting
PREFERRED_PROVIDER_virtual/i486-pc-linux-uclibc-libc-initial = "uclibc-initial"
IMAGE_LOGIN_MANAGER = "busybox"
IMAGE_INIT_MANAGER = "busybox"
IMAGE_DEV_MANAGER = "udev"

# GCC

# Autoconf

# X.org
PREFERRED_VERSION_xf86-video-intel = "2.16.0"
PREFERRED_PROVIDER_virtual/libx11 = "libx11"

# Boot Loader
# PEFERRED_VERSION_grub = "0.97"



# FEATURE SELECTION
# We want images supporting the following features (for task-base)
DISTRO_FEATURES = "nfs ipv4 ipv6 wifi alsa ext2 vfat pcmcia usbhost pci largefile nls xattr x86 x11"
TARGET_VENDOR = "-pc"
#TARGET_SYS ?= "i486-pc-uclibc-linux"

EFL_SRCREV = "51081"

# Additional content I (only valid if you include task-base)
# distro-feed-configs: configuration files for the online feeds
# util-linux-ng-mount util-linux-ng-umount: busybox mount is broken
# angstrom-libc-fixup-hack: fixes an obscure bug with libc.so symlink
#DISTRO_EXTRA_RDEPENDS += "\
#  distro-feed-configs \
#  util-linux-ng-mount util-linux-ng-umount \
#  angstrom-libc-fixup-hack \
#  ${DISTRO_EXTRA_APPS} \
#"

# Additional content II (can be masked with BAD_RECOMMENDATIONS)
#DISTRO_EXTRA_RRECOMMENDS += " \
#    kernel-module-vfat \
#    kernel-module-ext2 \
#    kernel-module-ext3 \
#    kernel-module-af-packet \
#    avahi-daemon \
#    avahi-autoipd \
#    openssh-sftp-server \
#"
```

## conf/machine/cocon486.conf
```bitbake
# Copyright (C) 2007, Stelios Koroneos - Digital OPSiS, All Rights Reserved
# Released under the MIT license (see packages/COPYING)
#@TYPE: Machine
#@NAME: COCON486
#@DESCRIPTION: Machine configuration for a Linux running on x86 compatible machines

require conf/machine/include/tune-x86.inc

TARGET_ARCH = "i486"
TUNE_ARCH = "i486"
MACHINE_FEATURES += "x86"

PREFERRED_PROVIDER_virtual/kernel = "linux-cocon486"
PREFERRED_PROVIDER_virtual/xserver = "xserver-xorg"
# LINUX_LIBC_HEADERS_VERSION ?= "3.0.27"
# PREFERRED_VERSION_linux-libc-headers = "${LINUX_LIBC_HEADERS_VERSION}"
# PREFERRED_VERSION_linux-libc-headers-native = "${LINUX_LIBC_HEADERS_VERSION}"

#XSERVER="xserver-kdrive-vesa"

KERNEL_IMAGETYPE = "bzImage"

MACHINE_EXTRA_RRECOMMENDS = " kernel-modules"
MACHINE_FEATURES = "kernel26 pci usbhost ext2 screen x86"

udevdir = "/dev"

# Kernel
PREFERRED_PROVIDER_virtual/kernel = "linux-cocon486"
KERNEL_IMAGETYPE = "bzImage"
```

## conf/machine/coconppc.conf
```bitbake
# Copyright (C) 2007, Stelios Koroneos - Digital OPSiS, All Rights Reserved
# Released under the MIT license (see packages/COPYING)
#@TYPE: Machine
#@NAME: COCONPPC
#@DESCRIPTION: Machine configuration for a Linux running on PowerPC (Mac) compatible machines

require conf/machine/include/tune-ppc603e.inc

TARGET_ARCH = "powerpc"
#TUNE_ARCH = ""

PREFERRED_PROVIDER_virtual/kernel = "linux-coconppc"
PREFERRED_PROVIDER_virtual/xserver = "xserver-xorg"


KERNEL_IMAGETYPE = "bzImage"

MACHINE_EXTRA_RRECOMMENDS = " kernel-modules"
MACHINE_FEATURES = "kernel26 pci usbhost ext2 screen ppc powerpc"

udevdir = "/dev"
```

## meta-coconport/ac100/conf/machine/ac100.conf
```bitbake
#@TYPE: Machine
#@NAME: ac100
#@DESCRIPTION: Toshiba ac100 netbook
TARGET_ARCH = "arm"
# TUNE_ARCH = "arm"
# TUNE_PKGARCH = "armv7a"
DEFAULTTUNE = "cortexa9hf"
# ARMPKGARCH = "armv7a"

PREFERRED_PROVIDER_virtual/xserver = "xserver-xorg"
XSERVER = "xserver-xorg \
           xf86-input-evdev \
           xf86-input-mouse \
           xf86-video-fbdev \
           xf86-input-keyboard"

# Only has DVI connector for external screen
GUI_MACHINE_CLASS = "bigscreen"

# require conf/machine/include/tune-cortexa9tegra.inc
require conf/machine/include/tune-cortexa9.inc

PREFERRED_PROVIDER_virtual/kernel = "linux-ac100"

#LINUX_LIBC_HEADERS_VERSION ?= "3.1.10"
PREFERRED_VERSION_linux-libc-headers = "${LINUX_LIBC_HEADERS_VERSION}"
PREFERRED_VERSION_linux-libc-headers-native = "${LINUX_LIBC_HEADERS_VERSION}"
PREFERRED_VERSION_linux-libc-headers-nativesdk = "${LINUX_LIBC_HEADERS_VERSION}"
PREFERRED_VERSION_linux-coconppc = "${LINUX_LIBC_HEADERS_VERSION}"

KERNEL_IMAGETYPE = "zImage"

MACHINE_EXTRA_RRECOMMENDS = " kernel-modules"


# and sdio
MACHINE_FEATURES = "kernel26 screen apm usbgadget usbhost vfat alsa usbhost ext2 ipv4 ipv6 wifi largefile nls xattr x11 argp udev sdio opengl"
```

## meta-coconport/cocon486/conf/machine/include/tune-x86.inc
```bitbake
DEFAULTTUNE ?= "i486"

require conf/machine/include/x86/arch-x86.inc

# Extra tune features
TUNEVALID[i486] = "Enable i486 specific processor optimizations"
TUNE_CCARGS += "${@bb.utils.contains("TUNE_FEATURES", "i486", "-march=i486", "", d)}"

# Extra tune selections
AVAILTUNES += "i486"
TUNE_FEATURES_tune-i486 = "${TUNE_FEATURES_tune-x86} i486"
BASE_LIB_tune-i486 = "lib"
TUNE_PKGARCH_tune-i486 = "i486"
PACKAGE_EXTRA_ARCHS_tune-i486 = "${PACKAGE_EXTRA_ARCHS_tune-x86} i386 i486"

#FEED_ARCH = "i486"
```

## meta-coconport/coconppc/conf/machine/coconppc.conf
```bitbake
# Copyright (C) 2007, Stelios Koroneos - Digital OPSiS, All Rights Reserved
# Released under the MIT license (see packages/COPYING)
#@TYPE: Machine
#@NAME: COCONPPC
#@DESCRIPTION: Machine configuration for a Linux running on PowerPC (Mac) compatible machines

require conf/machine/include/tune-ppc603e.inc

TARGET_ARCH = "powerpc"
#TUNE_ARCH = ""

PREFERRED_PROVIDER_virtual/kernel = "linux-coconppc"
PREFERRED_PROVIDER_virtual/xserver = "xserver-xorg"

LINUX_LIBC_HEADERS_VERSION ?= "3.0.84"
PREFERRED_VERSION_linux-libc-headers = "${LINUX_LIBC_HEADERS_VERSION}"
PREFERRED_VERSION_linux-libc-headers-native = "${LINUX_LIBC_HEADERS_VERSION}"
PREFERRED_VERSION_linux-libc-headers-nativesdk = "${LINUX_LIBC_HEADERS_VERSION
}"
PREFERRED_VERSION_linux-coconppc = "${LINUX_LIBC_HEADERS_VERSION}"

KERNEL_IMAGETYPE = "zImage"

MACHINE_EXTRA_RRECOMMENDS = " kernel-modules"
MACHINE_FEATURES = "kernel26 pci usbhost ext2 screen ppc powerpc ipv4 ipv6 wifi alsa vfat pcmcia largefile nls xattr x11 argp opengl udev"

udevdir = "/dev"
```
